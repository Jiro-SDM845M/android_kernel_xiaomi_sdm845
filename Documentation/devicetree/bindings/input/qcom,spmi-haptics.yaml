## Documentation/devicetree/bindings/input/qcom,spmi-haptics.yaml
```yaml
# SPDX-License-Identifier: (GPL-2.0-only OR BSD-2-Clause)
%YAML 1.2
---
$id: http://devicetree.org/schemas/input/qcom,spmi-haptics.yaml#
$schema: http://devicetree.org/meta-schemas/core.yaml#

title: Haptics device inside Qualcomm Technologies, Inc. PMIC

maintainers:
  - Fenglin Wu <fenglin.wu@oss.qualcomm.com>
  - Caleb Connolly <caleb@connolly.tech>

description: |
  Certain Qualcomm PMICs integrate a haptics module, such as the PMI8998
  or HAP530_HV module in the PMIH0108 PMIC. It supports linear resonant
  actuators (LRA) and eccentric rotating mass (ERM) type haptics.

properties:
  compatible:
    items:
      - enum:
          - qcom,pmi8998-haptics
          - qcom,pmi8996-haptics
          - qcom,pmi8941-haptics
          - qcom,pmih0108-haptics
      - const: qcom,spmi-haptics

  reg:
    minItems: 1
    maxItems: 2

  reg-names:
    items:
      - const: cfg
      - const: ptn

  interrupts:
    minItems: 1
    maxItems: 2

  interrupt-names:
    minItems: 1
    maxItems: 2

  qcom,vmax-microvolt:
    description: Maximum allowed output driving voltage in microvolts.
    minimum: 50000
    maximum: 10000000
    multipleOf: 50000

  qcom,lra-period-us:
    description: LRA actuator initial resonance period in microseconds.
    minimum: 5
    maximum: 20475
    multipleOf: 5

  qcom,actuator-type:
    description: The type of actuator attached to the hardware.
    $ref: /schemas/types.yaml#/definitions/uint32
    enum: [ 0, 1 ]
    default: 0

  qcom,wave-shape:
    description: Selects the wave shape to use.
    $ref: /schemas/types.yaml#/definitions/uint32
    enum: [ 0, 1 ]
    default: 0

  qcom,play-mode:
    description: Selects the play mode to use.
    $ref: /schemas/types.yaml#/definitions/uint32
    enum: [ 0, 1, 2, 3 ]
    default: 2

  qcom,wave-play-rate-us:
    description: Wave sample duration in microseconds.
    $ref: /schemas/types.yaml#/definitions/uint32
    minimum: 0
    maximum: 20475

  qcom,brake-pattern:
    minItems: 4
    maxItems: 4
    description: The brake pattern strengths.
    $ref: /schemas/types.yaml#/definitions/uint32-array
    default: [0x3, 0x3, 0x2, 0x1]

required:
  - compatible
  - reg
  - interrupts

additionalProperties: false
```
